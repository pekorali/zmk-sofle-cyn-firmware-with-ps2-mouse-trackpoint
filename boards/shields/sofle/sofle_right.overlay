#include "split_inputs.dtsi"
#include "sofle.dtsi"



//#include <input/processors/report_rate_limit.dtsi>
//#include <input/processors/xyz.dtsi>

&trackpoint_split { device = <&mouse_ps2>; };
//&trackpoint_split { device = <&mouse_ps2>; input-processors = <&zip_report_rate_limit 4>, <&zip_xyz>; };



&default_transform {
    col-offset = <6>;
};

&kscan0 {
    col-gpios
        = <&pro_micro 10 GPIO_ACTIVE_HIGH>
        , <&pro_micro 16 GPIO_ACTIVE_HIGH>
        , <&pro_micro 14 GPIO_ACTIVE_HIGH>
        , <&pro_micro 15 GPIO_ACTIVE_HIGH>
        , <&pro_micro 18 GPIO_ACTIVE_HIGH>
        , <&pro_micro 19 GPIO_ACTIVE_HIGH>
        ;
};

&right_encoder {
    status = "okay";
};
